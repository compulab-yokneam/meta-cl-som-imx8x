## conf/machine/cl-som-imx8x.conf
```bitbake
#@TYPE: Machine
#@NAME: CompuLab CL-SOM-iMX8X Evaluation Kit
#@SOC: i.MX8X
#@DESCRIPTION: Machine configuration for CompuLab cl-som-imx8x
#@MAINTAINER: compulab@compulab.co.il

MACHINEOVERRIDES =. "imx8qxp-mek:"
require conf/machine/imx8qxp-mek.conf

# U-Boot #
UBOOT_CONFIG ?= "sd"
UBOOT_CONFIG[sd] = "cl-som-imx8x_defconfig,sdcard"
UBOOT_CONFIG[fspi] = "cl-som-imx8x_defconfig"

# Kernel #
KERNEL_DEVICETREE =  "compulab/cl-som-imx8x.dtb "
KERNEL_DEVICETREE += "compulab/sb-imx8x.dtb "

# Firmware Images #
MACHINE_FIRMWARE = " linux-firmware-iwlwifi-8265"
MACHINE_FIRMWARE += " linux-firmware-ibt"
```

## conf/machine/cl-som-imx8x.inc
```bitbake
# U-Boot #
UBOOT_CONFIG ?= "sd"
UBOOT_CONFIG[sd] = "cl-som-imx8x_defconfig,sdcard"
UBOOT_CONFIG[fspi] = "cl-som-imx8x_defconfig"

# Kernel #
KERNEL_DEVICETREE =  "compulab/cl-som-imx8x.dtb "
KERNEL_DEVICETREE += "compulab/sb-imx8x.dtb "

# Firmware Images #
MACHINE_FIRMWARE = " linux-firmware-iwlwifi-8265"
MACHINE_FIRMWARE += " linux-firmware-ibt"
```

## conf/machine/cl-som-imx8xb0.conf
```bitbake
MACHINEOVERRIDES =. "imx8qxp-b0-mek:"
require conf/machine/imx8qxp-b0-mek.conf

require cl-som-imx8x.inc
```

## conf/machine/cl-som-imx8xc0.conf
```bitbake
#@TYPE: Machine
#@NAME: CompuLab CL-SOM-iMX8X Evaluation Kit
#@SOC: i.MX8X
#@DESCRIPTION: Machine configuration for CompuLab cl-som-imx8x
#@MAINTAINER: compulab@compulab.co.il

MACHINEOVERRIDES =. "imx8qxp-mek:"
require conf/machine/imx8qxp-mek.conf

require cl-som-imx8x.inc
```
